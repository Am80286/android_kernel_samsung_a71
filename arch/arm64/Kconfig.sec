## arch/arm64/Kconfig.sec
```kconfig
config SEC_A71_PROJECT
        default n
        bool "Samsung A71 Project"
        help
          Support for Samsung A71 Project

config SEC_A71_EUR_LDU_PROJECT
        default n
        bool "Samsung A71 EUR LDU Project"
        help
          Support for Samsung A71 EUR LDU Project

config SEC_A71_EUR_PROJECT
        default n
        bool "Samsung A71 EUR OPEN Project"
        help
          Support for Samsung A71 EUR OPEN Project

config SEC_M51_PROJECT
        default n
        bool "Samsung M51 Project"
        help
          Support for Samsung M51 Project

config SEC_M51_EUR_PROJECT
        default n
        bool "Samsung M51 EUR OPEN Project"
        help
          Support for Samsung M51 EUR OPEN Project

config SEC_R1Q_PROJECT
        depends on ARCH_SM6150
        default n
        bool "Samsung R1Q Project"
        help
          Support for Samsung R1Q Project

config SEC_R1Q_EUR_PROJECT
        depends on SEC_R1Q_PROJECT
        default n
        bool "Samsung R1Q EUR OPEN Project"
        help
          Support for Samsung A90Q EUR OPEN Project

config SEC_R1Q_EUR_LDU_PROJECT
        depends on SEC_R1Q_PROJECT
        default n
        bool "Samsung R1Q EUR LDU Project"
        help
          Support for Samsung R1Q EUR LDU Project
```
